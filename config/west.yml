## config/west.yml
```yaml
manifest:
  remotes:
    - name: zmkfirmware
      url-base: https://github.com/zmkfirmware
    - name: urob
      url-base: https://github.com/urob
  projects:
    - name: zmk
      remote: zmkfirmware
      revision: v0.3.0 # Pinned release. Move to v0.4 once tagged (board becomes nice_nano//zmk).
      import: app/west.yml
    - name: zmk-helpers
      remote: urob
      revision: v0.3.0 # Should match the ZMK release.
  self:
    path: config
```
